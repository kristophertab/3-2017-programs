/**
  ******************************************************************************
  * @file    main.c
  * @author  Ac6
  * @version V1.0
  * @date    01-December-2013
  * @brief   Default main function.
  ******************************************************************************
*/

#include <stdio.h>
#include <stdint.h>
#include "stm32f4xx.h"

#define LCD_DC	GPIO_Pin_1
#define LCD_CE	GPIO_Pin_2
#define LCD_RST	GPIO_Pin_3

volatile uint32_t timer_ms = 0;

void SysTick_Handler()
{
 if (timer_ms) {
 timer_ms--;
 }
}

void delay_ms(int time)
{
 timer_ms = time;
 while (timer_ms) {};
}

void lcd_reset(){
	GPIO_ResetBits(GPIOA, LCD_RST); //100 ns delay between, should be...
	delay_ms(1);
	GPIO_SetBits(GPIOA, LCD_RST);
}

void lcd_cmd(uint8_t cmd){
	GPIO_ResetBits(GPIOA, LCD_CE|LCD_DC);
	while (SPI_I2S_GetFlagStatus(SPI1, SPI_I2S_FLAG_TXE) == RESET);
	SPI_SendData(SPI1, cmd);
	GPIO_SetBits(GPIOA, LCD_CE);
}

void lcd_data(const uint8_t* data, int size){
	int i;
	GPIO_SetBits(GPIOA, LCD_DC);
	GPIO_ResetBits(GPIOA, LCD_CE);
	for(i=0;i<size;i++) {
		while (SPI_I2S_GetFlagStatus(SPI1, SPI_I2S_FLAG_TXE) == RESET);
		SPI_SendData(SPI1, data[i]);
	}
	GPIO_SetBits(GPIOA, LCD_CE);
}

const unsigned char logo_mini_mono [] = {
0xFC, 0xFE, 0xFF, 0xFF, 0xFF, 0xFF, 0xFF, 0xFF, 0xFF, 0xFF, 0xFF, 0xFF, 0xFF, 0xFF, 0xFF, 0xFF,
0xFF, 0xFF, 0xFF, 0xFF, 0xFF, 0xFF, 0xFF, 0xFF, 0xFF, 0xFF, 0xFF, 0xFF, 0xFF, 0xFF, 0xFF, 0xFF,
0xFF, 0x7F, 0x7F, 0x7F, 0xFF, 0x3F, 0x3F, 0x3F, 0x3F, 0x3F, 0x3F, 0x3F, 0x3F, 0x3F, 0x3F, 0x3F,
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0xFF, 0xFF, 0xFF, 0xFF, 0xFF, 0xFF, 0x7F, 0x3F,
};

static void All_Config(void)
{
	GPIO_InitTypeDef gpio;
	SPI_InitTypeDef  spi;

	SysTick_Config(SystemCoreClock / 1000);
	/* Enable the SPI clock */
	RCC_APB2PeriphClockCmd(RCC_APB2Periph_SPI1, ENABLE);
	/* Enable the GPIOA clock */
	RCC_AHB1PeriphClockCmd(RCC_AHB1Periph_GPIOA, ENABLE);
	/* Connect PA5 to SPI1_SCK */
	GPIO_PinAFConfig(GPIOA, GPIO_PinSource5, GPIO_AF_SPI1);
	/* Connect PA6 to SPI1_MISO */
	GPIO_PinAFConfig(GPIOA, GPIO_PinSource6, GPIO_AF_SPI1);
	/* Connect PA7 to SPI1_MOSI */
	GPIO_PinAFConfig(GPIOA, GPIO_PinSource7, GPIO_AF_SPI1);
	/* Configure SPI1 pins as alternate function (No need to
	configure PA4 since NSS will be managed by software) */

	 GPIO_StructInit(&gpio);
	 gpio.GPIO_Pin = GPIO_Pin_5|GPIO_Pin_7; // SCK, MOSI
	 gpio.GPIO_Mode = GPIO_Mode_AF;
	 gpio.GPIO_Speed = GPIO_Speed_50MHz; //speed
	 GPIO_Init(GPIOA, &gpio);

	 gpio.GPIO_Pin = GPIO_Pin_6; // MISO
	 gpio.GPIO_Mode = GPIO_Mode_IN;
	 GPIO_Init(GPIOA, &gpio);

	 gpio.GPIO_Pin = LCD_DC|LCD_CE|LCD_RST;
	 gpio.GPIO_Mode = GPIO_Mode_OUT;
	 GPIO_Init(GPIOC, &gpio);
	 GPIO_SetBits(GPIOC, LCD_CE|LCD_RST);

//	//manual:
//	gpio.GPIO_Pin =  GPIO_Pin_5|GPIO_Pin_6|GPIO_Pin_7;
//	gpio.GPIO_Mode = GPIO_Mode_AF;
//	gpio.GPIO_Speed = GPIO_Speed_50MHz;
//	gpio.GPIO_OType = GPIO_OType_PP;
//	gpio.GPIO_PuPd = GPIO_PuPd_UP;
//	GPIO_Init(GPIOA, &gpio);
	/* SPI configuration *****************************************/
//	spi.SPI_Direction = SPI_Direction_2Lines_FullDuplex; ???
	spi.SPI_Mode = SPI_Mode_Master;
//	spi.SPI_DataSize = SPI_DataSize_8b;
//	spi.SPI_CPOL = SPI_CPOL_High;
//	spi.SPI_CPHA = SPI_CPHA_2Edge;
	spi.SPI_NSS = SPI_NSS_Soft;
	spi.SPI_BaudRatePrescaler = SPI_BaudRatePrescaler_16;
//	spi.SPI_FirstBit = SPI_FirstBit_MSB;
//	spi.SPI_CRCPolynomial = 7;
	SPI_Init(SPI1, &spi);
	SPI_Cmd(SPI1, ENABLE);
}

int main(void)
{
	All_Config();

	lcd_reset();

	lcd_cmd(0x21);
	lcd_cmd(0x14);
	lcd_cmd(0x80 | 0x2f);
	lcd_cmd(0x20);
	lcd_cmd(0x0c);

	lcd_data(logo_mini_mono, sizeof(logo_mini_mono));

	while(1){

	}
}
